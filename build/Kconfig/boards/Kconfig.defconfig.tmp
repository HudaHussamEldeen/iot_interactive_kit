## build/Kconfig/boards/Kconfig.defconfig.tmp
```kconfig
# Load Zephyr board defconfig descriptions.
osource "/home/huda-hussam/zephyrproject/zephyr/boards/espressif/esp32s3_devkitc/Kconfig.defconfig"
```

## build/Kconfig/boards/Kconfig.esp32s3_devkitc
```kconfig
# Load board Kconfig descriptions.
osource "/home/huda-hussam/zephyrproject/zephyr/boards/espressif/esp32s3_devkitc/Kconfig.esp32s3_devkitc"
```

## iot_interactive_kit/build/Kconfig/arch/Kconfig.tmp
```kconfig
# Load Zephyr Arch Kconfig descriptions.
osource "/home/huda-hussam/zephyrproject/zephyr/arch/rx/Kconfig"
osource "/home/huda-hussam/zephyrproject/zephyr/arch/x86/Kconfig"
osource "/home/huda-hussam/zephyrproject/zephyr/arch/xtensa/Kconfig"
osource "/home/huda-hussam/zephyrproject/zephyr/arch/sparc/Kconfig"
osource "/home/huda-hussam/zephyrproject/zephyr/arch/riscv/Kconfig"
osource "/home/huda-hussam/zephyrproject/zephyr/arch/posix/Kconfig"
osource "/home/huda-hussam/zephyrproject/zephyr/arch/openrisc/Kconfig"
osource "/home/huda-hussam/zephyrproject/zephyr/arch/mips/Kconfig"
osource "/home/huda-hussam/zephyrproject/zephyr/arch/arm64/Kconfig"
osource "/home/huda-hussam/zephyrproject/zephyr/arch/arm/Kconfig"
osource "/home/huda-hussam/zephyrproject/zephyr/arch/arc/Kconfig"
```

## iot_interactive_kit/build/Kconfig/boards/Kconfig.sysbuild.tmp
```kconfig
# Load Sysbuild board Kconfig descriptions.
osource "/home/huda-hussam/zephyrproject/zephyr/boards/espressif/esp32s3_devkitc/Kconfig.sysbuild"
```
